## core/drivers/Kconfig
```kconfig
#
#  Changelog:
#  - [05/08/2015:SPR-010915-01] New 1553 driver configuration parameters added
#  - [29/03/2016:CP-250216-01] GR712-RC Watchdog driver added
#
menu "Drivers"

config DEV_UART
       tristate "Enable UART driver"
       depends on LEON2 || LEON3 || LEON4 || LEON3FT
       default y

config DEV_UART_1
       bool "Reserve UART1"
       default "y"
       depends on DEV_UART


config DEV_UART_2
       bool "Reserve UART2"
       default "y"
       depends on DEV_UART

config EARLY_OUTPUT
       bool "Enable early output"
       depends on (DEV_UART&&(LEON2||LEON3||LEON4||LEON3FT))
       default n

config EARLY_CPU_MHZ
       int "CPU frequency (MHz)"
       depends on EARLY_OUTPUT&&(LEON2||LEON3||LEON4||LEON3FT)
       default 45

config EARLY_UART_BAUDRATE
       int "Early UART baudrate"
       depends on EARLY_OUTPUT&&(LEON2||LEON3||LEON4||LEON3FT)
       default 115200

choice
        prompt "Select early UART port"
        default EARLY_UART1
        depends on EARLY_OUTPUT&&(LEON2||LEON3||LEON4||LEON3FT)

config EARLY_UART1
       bool "UART1"

config EARLY_UART2
       bool "UART2"

endchoice

config DEV_UART_FLOWCONTROL
       bool "Enable UART flow control"
       depends on DEV_UART
       default y

config DEV_NO_UARTS
       int
       default "2"
       depends on DEV_UART

config UART_THROUGH_DSU
       bool "DSU samples UART port"
       depends on (LEON2||LEON3||LEON4||LEON3FT) && !TSIM

config DEV_MEMBLOCK
       tristate "Enable memory block driver"
       default y

config DEV_FPGA_ITARFREE
       def_bool y
       depends on CPU_ITAR_FREE
#       depends on SPW_RTC || CPU_ITAR_FREE

config GR712_WATCHDOG
       bool "GR712 Watchdog Driver"
       depends on GR_712_RC
       help
         Includes the GR712 Watchdog driver.
       
menuconfig DEV_MIL_STD
           bool "Enable MIL-STD-1553 as MAF Synchronization"
           default n
           help
             Enable MAF synchronization with 1553 on IRQ 14. Use the SUBAD interrupt (#10) in the core1553BRM.
           depends on GR_712_RC && PLAN_EXTSYNC

if DEV_MIL_STD
config MIL_RT_ADDR
       int "Remote Terminal Address"
       default 20
       help
         RT address for the core.
       depends on GR_712_RC && PLAN_EXTSYNC

config MIL_DESC_MEM_ADDR
       hex "Descriptor Memory Address"
       default "0x40700000"
       help
         Each 1553B RT has a reserved location in memory for storing information on how to process various subaddresses and mode codes. The memory space is referred to as the Descriptor Table. This descriptor memory address contains the address that points to the top of this reserved memory space. The memory size should be at least 128KB.
       depends on GR_712_RC && PLAN_EXTSYNC

config MIL_STD_1553_ODD_PARITY
       bool "Enable odd parity"
       default y
       help
         Enable odd parity
       depends on GR_712_RC && PLAN_EXTSYNC

choice
     prompt "Select clock source"
     default MIL_STD_1553_INTERNAL_CLOCK

config MIL_STD_1553_INTERNAL_CLOCK
       bool "Internal clock (24Mhz)"
       help
         Select Internal GR712 clock as clock source. It is 24 Mhz.
       depends on GR_712_RC && PLAN_EXTSYNC

config MIL_STD_1553_CLKFREQ_12
       bool "External clock 12Mhz"
       help
         Use an external clock at 12Mhz.
       depends on GR_712_RC && PLAN_EXTSYNC

config MIL_STD_1553_CLKFREQ_16
       bool "External clock 16Mhz"
       help
         Use an external clock at 16Mhz.
       depends on GR_712_RC && PLAN_EXTSYNC

config MIL_STD_1553_CLKFREQ_20
       bool "External clock 20Mhz"
       help
         Use an external clock at 20Mhz.
       depends on GR_712_RC && PLAN_EXTSYNC

config MIL_STD_1553_CLKFREQ_24
       bool "External clock 24Mhz"
       help
         Use an external clock at 24Mhz.
       depends on GR_712_RC && PLAN_EXTSYNC

endchoice

endif

menuconfig LICE
	   bool "Enable LICE support"
	   default n
           depends on SPW_RTC || CPU_ITAR_FREE || GR_712_RC
if LICE
config DEV_LICE_INTERFACE
       bool "Trace internal XM events on LICE"
       default "y"
       depends on SPW_RTC || CPU_ITAR_FREE || GR_712_RC

config DEV_LICE_SCHEDULING
       bool "Trace scheduling XM events on LICE"
       default "y"
       depends on SPW_RTC || CPU_ITAR_FREE || GR_712_RC

config LICE_ADDRESS
       hex "LICE memory address"
       default "0x2C009000"
       depends on SPW_RTC || CPU_ITAR_FREE || GR_712_RC
endif

endmenu
```

## core/kernel/Kconfig
```kconfig
# Changelog:
# - [24/11/2015:SPR-241115-02] Added JMP_USR_FUNC_COLD_RESET_SYSTEM option
# - [20/11/2015:SPR-110915-01] IPVI_SUPPORT added. 
#      MAX_NO_IPVI depends on whether IPVI_SUPPORT is set or not.
# - [09/12/2016:CP-161202-01] MAX_CUSTOM_FILES added.

config EXPERIMENTAL
       bool "Enable experimental features"
       default n

config ASSERT
       bool "Enable assertions"
       default y

menuconfig DEBUG
	   bool "Debug and profiling support"
	   default y
	   
if DEBUG
config VERBOSE_TRAP
       bool "Dump CPU state when a trap is raised"
       default y
endif

config NO_GCC_OPT
       bool
       default n

config ID_STRING_LENGTH
       int "Max. identifier length (B)"
       default "16"
       
config MAX_NO_CUSTOMFILES
       int "Max. number of custom files"
       default "3"

menu "Hypervisor"

config VOLUNTARY_PREEMPTION
       bool "Enable voluntary preemption support"
       default "n"
       depends on EXPERIMENTAL

config KSTACK_KB
       int "Kernel stack size (KB)"
       default "8"

config NO_VCPUS
       int "Number of virtual CPUs"
       default "2"

if MULTICORE_SUPPORT

config IPVI_SUPPORT
       bool
       default "y"
endif

if !MULTICORE_SUPPORT
config IPVI_SUPPORT
       bool 'IPVI support'
       default "n"
endif

config MAX_NO_IPVI
       int "Number of IPVIs"
       default "4"
       depends on IPVI_SUPPORT

config MAX_NO_MAREAS
       int
       default "8"

config PLAN_EXTSYNC
       bool "Enable external synchronisation"
       default "n"

config AUDIT_EVENTS     
       bool "Enable kernel audit events"
       default "n"

config CORE_COMPRESSION
       bool "Compress kernel image"
       default "n"

config JMP_USR_FUNC_COLD_RESET_SYSTEM
       bool "Jump to user function on cold reset system"
       default "n"

endmenu

source "Kconfig.ver"

if MMU
source "kernel/mmu/Kconfig"
endif

if MPU
source "kernel/mpu/Kconfig"
endif

source "klibc/Kconfig"

source "drivers/Kconfig"
source "objects/Kconfig"
```

## core/kernel/sparcv8/Kconfig
```kconfig
# Changelog:
# - [17/11/2015:SPR-221015-01] LEON_EDAC_SUPPORT added

mainmenu "XM Configuration"

config SPARCv8
       def_bool y

config HWIRQ_PRIO_LBS
       def_bool y

config ARCH_MMU_BYPASS
	def_bool y

#config HWIRQ_PRIO_FBS
#       def_bool y

config CPU_NO_IRQS
       int
       default "16" if (LEON3||LEON2||LEON3FT)

config TARGET_BIG_ENDIAN
       def_bool y       

#config NO_CPUS
#       int
#       default "1"

menu "Processor"

choice
     prompt "SPARC cpu"
     default LEON3

config LEON2
       bool "Leon2"
       --help---
	Select this for a LEON2 processor.

config LEON3
       bool "Leon3"
       --help---
	Select this for a LEON3 processor.

config LEON3FT
       bool "Leon3FT"
	   --help---
	Select this for a LEON3FT processor.

config LEON4
       bool "Leon4"
       --help---
	Select this for a LEON4 processor.

endchoice

choice
     prompt "Board"
     default TSIM if LEON3 || LEON3FT
     default GR_CPCI_XC4VLX200 if LEON4

config TSIM
       bool "TSim"
       depends on LEON2 || LEON3 || LEON3FT

config GR_CPCI_XC4V
       bool "GR-CPCI-XC4V"
       depends on LEON3

config GR_PCI_XC2V
       bool "GR-PCI-XC2V"
       depends on LEON2

config GR_712_RC
       bool "GR712RC"
       depends on LEON3FT

config CPU_ITAR_FREE
       bool "CPU-ITAR-FREE"
       depends on LEON2

config SPW_RTC
       bool "SpW-RTC"
       depends on LEON2

config SIMLEON
       bool "SIMLEON"
       depends on LEON2

config GR_CPCI_XC4VLX200
       bool "GR-CPCI-XC4VLX200"
       depends on LEON4

endchoice

choice
     prompt "Multicore support"
     default NONE

config NONE
       bool "None"
       --help---
       Select this to disable multicore support.

config AMP_SUPPORT
       bool "AMP support"
       --help---
	Select this to enable AMP support.

config SMP_SUPPORT
       bool "SMP support"
       --help---
	Select this to enable SMP support.
endchoice

config NO_CPUS
       int "Number of CPUs supported"
       default "4" if (GR_CPCI_XC4VLX200)
       default "2" if (GR_712_RC)
       default "1" if (!GR_712_RC)
       depends on SMP_SUPPORT

config MULTICORE_SUPPORT
       bool
       default "n" if (!AMP_SUPPORT&&!SMP_SUPPORT)
       default "y" if (AMP_SUPPORT||SMP_SUPPORT)

config NO_HWIRQS
       int
       default "16" if (TSIM||GR_CPCI_XC4V||GR_PCI_XC2V||GR_712_RC||SIMLEON)
       default "31" if (CPU_ITAR_FREE)
       default "32" if (SPW_RTC||LEON4)

config CPU_ITAR_FREE_SIM
       def_bool y
       depends on SIMLEON

config AT697F
       def_bool y
       depends on CPU_ITAR_FREE || SPW_RTC

config AT697E
       def_bool y
       depends on GR_PCI_XC2V || SIMLEON

choice
     prompt "SPARC memory protection schema"
     default MMU

config MPU
       bool "MPU (Write Protection Registers)"
       depends on LEON2

config WA_PROTECT_MMAP_PREG_WPOINT
       def_bool y
       depends on MPU

config MMU
       bool "MMU"
       depends on !GR_CPCI_AT697E

endchoice

config WATCHDOG
       bool "Enable watchdog"
       default n
       depends on SPW_RTC

config WATCHDOG_NMAF
       int "Reset watchdog every N MAFs"
       default 1
       depends on WATCHDOG

config WATCHDOG_TIMEOUT
       int "Watchdog timeout"
       default 5000000
       depends on WATCHDOG        

config UART_TIMEOUT
       int
       default 500 if !UART_THROUGH_DSU
       default 120000 if UART_THROUGH_DSU

config LEON_EDAC_SUPPORT
       bool "EDAC support"
       default y
       depends on GR_712_RC

config ENABLE_CACHE
       bool "Enable cache"
       default y

config CACHE_SNOOP
       bool "Enable cache snoop"
       depends on ENABLE_CACHE
       default y

config CACHE_IBURST_FETCH
       bool "Enable instruction burst fetch"
       depends on ENABLE_CACHE
       default y

config FLUSH_CACHE_AFTER_CS
       bool "Flush cache after context switch"
       depends on ENABLE_CACHE
       default y
choice
        prompt "Select L2 cache write policy"
        default COPY_BACK
        depends on ENABLE_CACHE&&LEON4

config COPY_BACK
       bool "Copy-back"

config WRITE_THROUGH
       bool "Write-through"

endchoice

config ENABLE_POWERDOWN
       bool "Enable Power-Down"
       default y
       depends on LEON3 || LEON4 || LEON3FT

config WA_PROTECT_MMAP_PREG_WPOINT
       def_bool y
       depends on GR_CPCI_AT697E

endmenu

menu "Physical memory layout"
config XM_LOAD_ADDR
       hex "XM load address"
       default "0x0" if LEON4
       default "0x40000000" if (LEON2||LEON3||LEON3FT)

config XM_OFFSET
       hex "XM virtual address"
!       default XM_LOAD_ADDR if !MMU
       depends on MMU
       default "0xFC000000" if MMU

endmenu

config XM_OFFSET
       default XM_LOAD_ADDR if !MMU
       depends on MPU


source "kernel/Kconfig"
```

## core/objects/Kconfig
```kconfig
menu "Objects"

config OBJ_HM_VERBOSE
       bool "Verbose HM events"
       default y

config OBJ_STATUS_ACC
       bool "Enable XM/partition status accounting"
       default n

config OBJ_TRACE_LOG_NO_ELEM
       int "Size of the XM's internal buffer to store trace logs"
       default "20"

config OBJ_HM_LOG_NO_ELEM
       int "Size of the XM's internal buffer to store hm logs"
       default "20"

config OBJ_MAX_NO_COMMPORTS
       int "Maximum number of communication ports"
       default "256"

endmenu
```

## user/bootloaders/rsw/Kconfig
```kconfig
# Changelog:
#  - [02/10/2015:SPR-021015-01] USE_XEF_EPOINT added
config STACK_SIZE
       int "Stack size (KB)"
       default "8"

config STAND_ALONE
       bool "Stand-alone version"
       default no

config CONTAINER_AT_FIXED_ADDR
       bool "Load container at a fixed address"
       default y

config USE_XEF_EPOINT
       bool "Update partition entry point with XEF"

source "../../../core/Kconfig.ver"
```

## user/bootloaders/rsw/sparcv8/Kconfig
```kconfig
mainmenu "RSW Configuration"

source "Kconfig"

menu "RSW memory layout"

config CONTAINER_ADDR
       hex "Container physical location address"
       default "0x4000"
       depends on STAND_ALONE||CONTAINER_AT_FIXED_ADDR

config RDONLY_SEC_ADDR
       hex "Read-only section addresses"
       default "0x40200000"

config RW_SEC_ADDR
       hex "Read/write section addresses"
       default "0x40090000"

endmenu

config OUTPUT_ENABLED
       bool "Enable RSW output"
       default y

config CPU_FREQ_AUTO
       bool "Autodetect CPU frequency"
       default y

config CPU_KHZ
       int "CPU frequency (KHz)"
       default "50000"
       depends on OUTPUT_ENABLED&&!CPU_FREQ_AUTO

choice
	prompt "Enable UART support"
	default UART1
        depends on OUTPUT_ENABLED

config UART1
       bool "UART1"
config UART2
       bool "UART2"

endchoice

config UART_FLOWCONTROL
       bool "Enable UART flow control"
       depends on OUTPUT_ENABLED
       default y

config UART_BAUDRATE
       int "UART baud rate"
       default "115200"
       depends on OUTPUT_ENABLED
```
